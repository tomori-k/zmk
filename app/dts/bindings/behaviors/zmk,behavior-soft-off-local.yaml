## app/dts/bindings/behaviors/zmk,behavior-soft-off-local.yaml
```yaml
# Copyright (c) 2025 The ZMK Contributors
# SPDX-License-Identifier: MIT

description: Soft-Off Behavior

compatible: "zmk,behavior-soft-off-local"

include: zero_param.yaml

properties: {}
```
